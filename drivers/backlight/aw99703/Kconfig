## drivers/backlight/aw99703/Kconfig
```kconfig
config BACKLIGHT_LEDS_AW99703
        tristate "Backlight LEDs aw99703"
        default n
        help
         Say Y here if you have a aw99703 compatible
         device connected.

         This driver can also be built as a module.  If so, the module
         will be called leds_aw99703.
```

## drivers/backlight/lm3697/Kconfig
```kconfig
config BACKLIGHT_LEDS_LM3697
        tristate "Backlight LEDs lm3697"
        default n
        help
         Say Y here if you have a lm3697 compatible
         device connected.

         This driver can also be built as a module.  If so, the module
         will be called leds_lm3697.
```

## drivers/input/misc/fpc_fps_mmi/Kconfig
```kconfig
config FPC_FPS_MMI
	tristate "FPC FPS MMI"
	default n
	help
	 Say Y here if you wish to include support
	 If unsure, say N.

config INPUT_MISC_FPC1020_SAVE_TO_CLASS_DEVICE
        bool "FPC1020 Save to Class Device"
        default n
        depends on FPC_FPS_MMI
        help
         Say Y here if you wish to include support
         sysfs.
         If unsure, say N.
```

## drivers/input/misc/goodix_fod_mmi/Kconfig
```kconfig
config FINGERPRINT_GOODIX_FOD_MMI
	tristate "Goodix FOD support"

config INPUT_MISC_GOODIX_FOD_SOFTDEP
	bool "Goodix FOD softdependency on GPIO_PCAL6408"
	depends on FINGERPRINT_GOODIX_FOD_MMI
```

## drivers/input/misc/rbs_fps_mmi/Kconfig
```kconfig
config RBS_FPS_MMI
	tristate "RBS FPS MMI"
	default n
	help
	 Say Y here if you wish to include support
	 If unsure, say N.

config EGIS_PANEL_NOTIFICATIONS
	bool "EGIS PANEL MODIFICATIONS support"
	default n
	depends on RBS_FPS_MMI
	help
	 Say Y here if you wish to include support
         sysfs.
	 If unsure, say N.

config ET721_FOD
        bool "ET721 fod  support"
        default n
        depends on RBS_FPS_MMI
        help
         Say Y here if you wish to include support
         sysfs.
         If unsure, say N.
```

## drivers/input/touchscreen/focaltech_touch_v3_4/Kconfig
```kconfig
#
# Focaltech Touchscreen driver configuration
#

config TOUCHSCREEN_FTS_V3_4
    bool "Focaltech Touchscreen v3"
    default n
    help
      Say Y here if you have Focaltech touch panel.
      If unsure, say N.

config TOUCHSCREEN_FTS_DIRECTORY_V3_4
    string "Focaltech ts v3.4 directory name"
    default "focaltech_touch_v3_4"
    depends on TOUCHSCREEN_FTS_V3_4
```

## drivers/input/touchscreen/touchscreen_mmi/Kconfig
```kconfig
config INPUT_TOUCHSCREEN_MMI
	tristate "Moto touchscreen gestures"
	default n
	help
	 Say Y here if you wish to include support for Moto touchscreen gestures.
	 If unsure, say N.

config TOUCHCLASS_MMI_DEBUG_INFO
	bool "Moto touchscreen gestures debug info"
	depends on INPUT_TOUCHSCREEN_MMI
	default n
	help
	 Say Y here if you wish to include support for Moto touchscreen gestures debugging info.
	 If unsure, say N.

config DRM_DYNAMIC_REFRESH_RATE
	bool "Moto DRM dynamic refresh rate"
	depends on INPUT_TOUCHSCREEN_MMI
	default n
	help
	 Say Y here if your panel supports drm dynamic refresh rate.
	 If unsure, say N.

config INPUT_TOUCHSCREEN_MMI_I2C
	bool "Touchscreen MMI I2C"

config TOUCHCLASS_MMI_GESTURE_POISON_EVENT
	bool "Moto gestures event poison"
	depends on INPUT_TOUCHSCREEN_MMI
	default n
	help
	 Say Y here if you wish to include support for Moto gestures event poison.
	 If unsure, say N.

config TOUCHCLASS_MMI_MULTIWAY_UPDATE_FW
        bool "Touchscreen Update FW"

config DRM_PANEL_NOTIFICATIONS
	bool "Moto DRM panel notifications"
	depends on INPUT_TOUCHSCREEN_MMI
	default n
	help
	 Say Y here if your panel includes support for drm notifications.
	 If unsure, say N.

config BOARD_USES_DOUBLE_TAP_CTRL
	bool "Board uses Double Tap Control"
```

## drivers/misc/awinic/Kconfig
```kconfig
#
# Awinic Haptic
#

menuconfig INPUT_AWINIC_HAPTIC
	bool "Awinic Haptic"
	default n
	help
	  Enables Awinic Haptic driver.

source "drivers/misc/awinic/aw862x/Kconfig"

source "drivers/misc/awinic/aw8695/Kconfig"
```

## drivers/misc/mmi_sys_temp/Kconfig
```kconfig
config MMI_SYS_TEMP
        tristate "MMI SYS TEMP"
        default n
        help
         Say Y here if you have a mmi sys temp compatible
         device connected.

         This driver can also be built as a module.  If so, the module
         will be called mmi_sys_temp.
```

## drivers/nfc/sec_nfc/Kconfig
```kconfig
config SEC_NFC_PRODUCT_N5
	tristate "sec nfc product n5"

config SEC_NFC_IF_I2C
	tristate "sec nfc i2c"
```

## drivers/power/Kconfig
```kconfig
# SPDX-License-Identifier: GPL-2.0-only
source "drivers/power/avs/Kconfig"
source "drivers/power/reset/Kconfig"
source "drivers/power/supply/Kconfig"

source "drivers/power/bm_adsp_ulog/Kconfig"
source "drivers/power/mmi_charger/Kconfig"
source "drivers/power/qpnp_adaptive_charge/Kconfig"
```

## drivers/power/bm_adsp_ulog/Kconfig
```kconfig
config BM_ADSP_ULOG
        tristate "BM ADSP ULOG"
        default n
        help
         Say Y here if you have a bm adsp ulog compatible
         device connected.

         This driver can also be built as a module.  If so, the module
         will be called bm_adsp_ulog.
```

## drivers/power/mmi_charger/Kconfig
```kconfig
config USE_MMI_CHARGER
        tristate "MMI CHARGER"
        default n
        help
         Say Y here if you have a mmi charger compatible
         device connected.

         This driver can also be built as a module.  If so, the module
         will be called mmi_charger.
```

## drivers/power/mmi_charger/qti_glink_charger/Kconfig
```kconfig
config QTI_GLINK_CHARGER
        tristate "QTI GLINK CHARGER"
        default n
        help
         Say Y here if you have a mmi charger compatible
         device connected.

         This driver can also be built as a module.  If so, the module
         will be called qqti_glink_charger.
```

## drivers/regulator/aw37501/Kconfig
```kconfig
config REGULATOR_AW37501
        tristate "AW37501 REGULATOR"
        default n
        help
         Say Y here if you have a AW37501 compatible
         device connected.

         This driver can also be built as a module.  If so, the module
         will be called aw37501-regulator.
```

## drivers/sensors/Kconfig
```kconfig
config SENSORS_CLASS
	tristate "Enable Sensors Class Driver Support"
	help
	  Add support for sensors CLASS driver.
```
