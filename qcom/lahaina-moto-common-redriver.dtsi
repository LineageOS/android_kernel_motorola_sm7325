redriver: redriver@1a {
	compatible = "onnn,redriver";
	reg = <0x1a>;
	vcc-supply = <&S10B>;
	pinctrl-names = "enable_gpio";
	pinctrl-0 = <&usb3phy_portselect_gpio &redriver_enable>;
	orientation_gpio = <&tlmm 81 0>;

	eq = /bits/ 8 <
			/* Parameters for USB */
			0x4 0x4 0x4 0x4
			/* Parameters for DP */
			0x6 0x4 0x4 0x6>;
	flat-gain = /bits/ 8 <
			/* Parameters for USB */
			0x3 0x1 0x1 0x3
			/* Parameters for DP */
			0x2 0x1 0x1 0x2>;
	output-comp = /bits/ 8 <
			/* Parameters for USB */
			0x3 0x3 0x3 0x3
			/* Parameters for DP */
			0x3 0x3 0x3 0x3>;
	loss-match = /bits/ 8 <
			/* Parameters for USB */
			0x1 0x3 0x3 0x1
			/* Parameters for DP */
			0x3 0x3 0x3 0x3>;
};
