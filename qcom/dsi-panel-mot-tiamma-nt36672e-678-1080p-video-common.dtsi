&mdss_mdp {
	dsi_nt36672e_fhd_plus_144_video: qcom,mdss_dsi_nt36672e_fhd_plus_144_video {
		qcom,mdss-dsi-panel-name =
			"mipi_mot_vid_tianma_1080p_dsc_678";
		qcom,mdss-dsi-panel-type = "dsi_video_mode";
		qcom,dsi-ctrl-num = <0>;
		qcom,dsi-phy-num = <0>;
		qcom,mdss-dsi-virtual-channel-id = <0>;
		qcom,mdss-dsi-stream = <0>;
		qcom,mdss-dsi-bpp = <24>;
		qcom,mdss-dsi-border-color = <0>;
		qcom,mdss-dsi-traffic-mode = "burst_mode";
		qcom,mdss-dsi-bllp-power-mode;
		qcom,mdss-dsi-bllp-eof-power-mode;
		qcom,mdss-dsi-lp11-init;
		qcom,mdss-dsi-lane-0-state;
		qcom,mdss-dsi-lane-1-state;
		qcom,mdss-dsi-lane-2-state;
		qcom,mdss-dsi-lane-3-state;
		qcom,mdss-dsi-dma-trigger = "trigger_sw";
		qcom,mdss-dsi-mdp-trigger = "none";
		qcom,mdss-dsi-reset-sequence = <1 10>, <0 10>, <1 10>;
		qcom,mdss-dsi-tx-eot-append;
		qcom,adjust-timer-wakeup-ms = <1>;
		qcom,mdss-dsi-panel-hdr-enabled;
		qcom,mdss-dsi-panel-hdr-color-primaries = <15100 15745 32800
						 16850 15150 32350 7450 3000>;
		qcom,mdss-dsi-panel-peak-brightness = <4500000>;
		qcom,mdss-dsi-panel-blackness-level = <3000>;

		qcom,mdss-pan-physical-width-dimension = <69>;
		qcom,mdss-pan-physical-height-dimension = <157>;

		qcom,mdss-dsi-cabc-mv-command = [15 01 00 00 00 00 02 55 03];
		qcom,mdss-dsi-cabc-mv-command-state =  "dsi_lp_mode";
		qcom,mdss-dsi-cabc-ui-command = [15 01 00 00 00 00 02 55 01];
		qcom,mdss-dsi-cabc-ui-command-state =  "dsi_lp_mode";
		qcom,mdss-dsi-cabc-dis-command = [15 01 00 00 00 00 02 55 00];
		qcom,mdss-dsi-cabc-dis-command-state =  "dsi_lp_mode";

		qcom,mdss-dsi-hbm-on-command = [15 01 00 00 00 00 02 51 FF];
		qcom,mdss-dsi-hbm-on-command-state =  "dsi_lp_mode";
		qcom,mdss-dsi-hbm-off-command = [15 01 00 00 00 00 02 51 CC];
		qcom,mdss-dsi-hbm-off-command-state =  "dsi_lp_mode";
		qcom,mdss-dsi-hbm-type = "lcd-dcs-wled";

		qcom,mdss-dsi-display-timings {
			timing@0 {
				qcom,mdss-dsi-panel-width = <1080>;
				qcom,mdss-dsi-panel-height = <2460>;
				qcom,mdss-dsi-h-front-porch = <28>;
				qcom,mdss-dsi-h-back-porch = <18>;
				qcom,mdss-dsi-h-pulse-width = <4>;
				qcom,mdss-dsi-h-sync-skew = <0>;
				qcom,mdss-dsi-v-back-porch = <20>;
				qcom,mdss-dsi-v-front-porch = <3610>;
				qcom,mdss-dsi-v-pulse-width = <10>;
				qcom,mdss-dsi-panel-framerate = <60>;
				qcom,mdss-dsi-on-command = [
					29 01 00 00 00 00 02 FF 20
					29 01 00 00 00 00 02 FF 10
					29 01 00 00 00 00 02 FB 01
					29 01 00 00 00 00 02 36 00
					29 01 00 00 00 00 06 3B 03 14 3C 04 04
					29 01 00 00 00 00 02 B0 00
					29 01 00 00 00 00 02 C0 03
					29 01 00 00 00 00 03 C2 1B A0
					29 01 00 00 00 00 02 E9 01

					29 01 00 00 00 00 02 FF E0
					29 01 00 00 00 00 02 FB 01
					29 01 00 00 00 00 02 35 82
					29 01 00 00 00 00 02 85 32

					29 01 00 00 00 00 02 FF F0
					29 01 00 00 00 00 02 FB 01
					29 01 00 00 00 00 02 1C 01
					29 01 00 00 00 00 02 33 01
					29 01 00 00 00 00 02 5A 00
					29 01 00 00 00 00 02 9F 0C

					29 01 00 00 00 00 02 FF D0
					29 01 00 00 00 00 02 FB 01
					29 01 00 00 00 00 02 53 22
					29 01 00 00 00 00 02 54 02

					29 01 00 00 00 00 02 FF C0
					29 01 00 00 00 00 02 FB 01
					29 01 00 00 00 00 02 9C 11
					29 01 00 00 00 00 02 9D 11

					29 01 00 00 00 00 02 FF 10
					29 01 00 00 00 00 02 FB 01
					29 01 00 00 00 00 02 C0 03

					15 01 00 00 00 00 02 51 CC
					15 01 00 00 00 00 02 53 2C
					15 01 00 00 00 00 02 55 01

					05 01 00 00 64 00 01 11
					05 01 00 00 28 00 01 29
				];
				qcom,mdss-dsi-on-command-state = "dsi_lp_mode";
				qcom,mdss-dsi-off-command = [
					05 01 00 00 10 00 01 28
					05 01 00 00 32 00 01 10
				];
				qcom,mdss-dsi-off-command-state = "dsi_lp_mode";
				qcom,compression-mode = "dsc";
				qcom,mdss-dsc-slice-height = <20>;
				qcom,mdss-dsc-slice-width = <540>;
				qcom,mdss-dsc-slice-per-pkt = <2>;
				qcom,mdss-dsc-bit-per-component = <8>;
				qcom,mdss-dsc-bit-per-pixel = <8>;
				qcom,mdss-dsc-block-prediction-enable;
			};
		};
	};
};
