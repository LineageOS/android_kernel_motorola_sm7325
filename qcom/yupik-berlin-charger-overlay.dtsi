&mmi_charger {
	compatible = "mmi,mmi-charger";
	mmi,enable-charging-limit;
	mmi,enable-factory-poweroff;
	mmi,upper-limit-capacity = <75>;
	mmi,lower-limit-capacity = <60>;
	mmi,heartbeat-interval = <60000>;
	mmi,dcp-power-max = <10000>;
	mmi,hvdcp-power-max = <20000>;
};

&qti_glink_charger {
	compatible = "mmi,qti-glink-charger";
	mmi,df-serialnum = "unknown-sn";
	mmi,demo-fv-mv = <4000>;
	profile-ids-map = "107000", "SB18D10750";
};
