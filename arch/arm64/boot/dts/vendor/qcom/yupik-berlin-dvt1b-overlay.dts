/* Copyright (c) 2020, The Linux Foundation. All rights reserved.
 *
 * This program is free software; you can redistribute it and/or modify
 * it under the terms of the GNU General Public License version 2 and
 * only version 2 as published by the Free Software Foundation.
 *
 * This program is distributed in the hope that it will be useful,
 * but WITHOUT ANY WARRANTY; without even the implied warranty of
 * MERCHANTABILITY or FITNESS FOR A PARTICULAR PURPOSE.  See the
 * GNU General Public License for more details.
 */

/dts-v1/;
/plugin/;

#include "yupik-berlin-overlay.dtsi"

/ {
	model = "Berlin";
	compatible = "qcom,yupik-Berlin", "qcom,yupik-moto", "qcom,yupik";
	qcom,msm-id = <475 0x10000>;
	qcom,board-id = <0x41 0xB1B0>;
};

&pm8350c_l2 {
	qcom,init-voltage = <1800000>;
};

&qupv3_se13_i2c {
	st_fts@49 {
		st,regulator_dvdd = "pm8350c_l2";
	};
};
