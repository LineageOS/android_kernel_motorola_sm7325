/* Copyright (c) 2020, The Linux Foundation. All rights reserved.
 *
 * This program is free software; you can redistribute it and/or modify
 * it under the terms of the GNU General Public License version 2 and
 * only version 2 as published by the Free Software Foundation.
 *
 * This program is distributed in the hope that it will be useful,
 * but WITHOUT ANY WARRANTY; without even the implied warranty of
 * MERCHANTABILITY or FITNESS FOR A PARTICULAR PURPOSE.  See the
 * GNU General Public License for more details.
 */

/dts-v1/;
/plugin/;

#include "lahaina-moto-tundra-overlay.dtsi"

/ {
	model = "Tundra";
	platinfo = "Qualcomm Technologies, Inc SM8350";
	compatible = "qcom,lahaina-Tundra", "qcom,lahaina-moto", "qcom,lahaina";
	qcom,msm-id = <415 0x20001>;
	qcom,board-id = <0x41 0xB100>;
};

&qti_glink_charger {
        mmi,df-serialnum = "SB18D47432";
	profile-ids-map = "38000", "SB18D47432","38000","SB18D47433";
};

